## arch/arm64/configs/apollo_defconfig
```kconfig
#
#
# Apollo Defconfig
#
#
CONFIG_BOEFFLA_WL_BLOCKER=y
CONFIG_CUSTOM_FORCETOUCH=y
CONFIG_SEC_INPUT_BOOSTER=y
CONFIG_ARGOS=y
CONFIG_ARGOS_CLUSTER_NUM=2
CONFIG_PROC_AVC=y
CONFIG_PAGE_BOOST=y
CONFIG_PAGE_BOOST_RECORDING=y
CONFIG_PROCESS_RECLAIM=y
CONFIG_INCREASE_MAXIMUM_SWAPPINESS=y
CONFIG_KSWAPD_CPU=0x3F

#
# MoroSound
#
CONFIG_MORO_SOUND=y

#
# Flar2 Wake Gestures
#
CONFIG_WAKE_GESTURES=y

#
# Wireguard
#
CONFIG_WIREGUARD=y
# CONFIG_WIREGUARD_DEBUG is not set


#
# Scheduler features
#
# CONFIG_PELT_HALFLIFE_32 is not set
CONFIG_PELT_HALFLIFE_16=y
# CONFIG_PELT_HALFLIFE_8 is not set

#
# IKHEADERS
#
CONFIG_IKHEADERS=y

# Enable power efficient workqueues

#
# Incremental Filesystem
#
CONFIG_INCREMENTAL_FS=y
CONFIG_KSU=y
CONFIG_KSU_MANUAL_HOOK=y
CONFIG_KSU_SUSFS=y
CONFIG_KSU_SUSFS_SUS_PATH=y
CONFIG_KSU_SUSFS_SUS_MOUNT=y
CONFIG_KSU_SUSFS_AUTO_ADD_SUS_BIND_MOUNT=y
CONFIG_KSU_SUSFS_HIDE_KSU_SUSFS_SYMBOLS=y
CONFIG_KSU_SUSFS_SUS_KSTAT=y
CONFIG_KSU_SUSFS_OPEN_REDIRECT=y
CONFIG_KSU_SUSFS_SUS_MAP=y
CONFIG_KSU_SUSFS_SPOOF_UNAME=y
CONFIG_KSU_SUSFS_SPOOF_CMDLINE_OR_BOOTCONFIG=y
CONFIG_KSU_SUSFS_ENABLE_LOG=y
```
